/*
  TEF6686 lithio 1.02 patch 2.22 AM FM XDR-GTK 1.0
  by VoXiTPro
  changes: 
  all warnings are removed  (unsigned int to signed int did go wrong)
  Filters are now switchable (AUTO is max 236khz, manual you can set 311Khz)
  Stereo on/off
  Signal measurement improvements
  Keep filter (to do) and frequency settings when switching from AM to FM / FM to AM
  Settings are now from Eustake (marsel90)
  AGC is now switchable (now for FM/AM and reversed the settings) 
  Removed some settings from Eustake, FMSI stereo improvement only for tef6687 and tef6689, Softmute_mod AM only, Wavegen and I2S audio (only using internal audio)
  You can now change settings with the antenne switch ANT A = default settings, ANT B = Improved settings, ANT C = Eustake Settings
  Settings are now A,B,C from eustake. D are improved settings from prog manual.
  AGC, Deemphasis, IF+ RF+ are now in subroutines so you can set them at other moments. If you change settings the old values will be reapplied.
  IF+ RF+ works now also for AM.
  Squelch will change volume scale for AM.  if you have the right value change the define AM_VOL_SCALE too that value (now -1)
*/  
#define AM_VOL_SCALE -1
/*  
 If you have changed the above value squelch will be off again.
 Switching from AM to FM or from FM to AM filter settings are kept
 

  Special thanks to Konrad Kosmatka, author of the original version for Sony XDR-F1HD
  https://fmdx.pl/xdr-i2c/
  https://fmdx.pl/xdr-gtk/
  Thanks also to:
  - RTVDXRO his version was the base for this version https://github.com/RTVDXRO/NXP-TEF6686-Arduino-Radio
  - FMDXklaas for testing
  - ODJeetje 
  - Eustake for default and improved settings 
  and many others ...
  Tested on Arduino Nano V3.0 at 5V
*/



/* Filtersettings at the moment
XDR-GTK/XDR filter index to TEF6686 filter  *=XDR-GTK
FM BW* FM BW  AM BW* AM BW
Auto   Auto          
9k      56k   1.1k   3k 
15k     56k   1.9k   3k 
17k     56k   2.2k   3k 
20k     56k   2.5k   3k 
24k     56k   2.9k   3k 
27k     56k   3.4k   3k 
32k     56k   3.9k   4k 
36k     56k   4.6k   4k 
42k     56k   5.2k   4k 
48k     56k   6.0k   6k 
55k     56k   6.9k   6k 
63k     64k   7.9k   8k 
73k     72k   9.1k   8k 
83k     84k  10.4k   8k 
90k     84k  11.3k   8k 
95k     97k  11.8k   8k 
108k   114k  13.5k   8k 
125k   133k  15.6k   8k 
142k   151k  17.8k   8k 
159k   168k  19.9k   8k 
177k   184k  22.1k   8k 
194k   200k  24.3k   8k 
211k   217k  26.4k   8k 
229k   236k  28.6k   8k 
246k   254k  30.8k   8k 
263k   287k  32.9k   8k 
281k   311k  35.1k   8k 
298k   311k  37.3k   8k 
309k   311k  38.6k   8k 
*/

/* Startup XDR-GTK
 *  Yxxx volume XDR-GTK keep settings
 *  Q0 Squelch start always on 0
 *  M0 Mode FM
 *  T8750 Freq 87.50 Mhz
 *  Ax AGC XDR-GTK keep settings
 *  F-1 Filter start always on auto -1
 *  D0 de-emphasis XDR-GTK keep settings 
 *  G00 RF+ and IF+ XDR-GTK keep settings
 *  Z0 Antenne Selector (Now settings) always 0
*/

#include <Wire.h>

#define SERIAL_PORT_SPEED 115200
#define SERIAL_BUFFER_SIZE 16
char buff[SERIAL_BUFFER_SIZE];
uint8_t buff_pos = 0;
uint32_t REG_FREQ;
uint32_t MODA_FREQ = 0;
uint32_t MODF_FREQ = 0;
uint32_t timer = 0;          // Signal level reporting timer
uint32_t timer_DATA = 0;     // DATA reporting timer
int8_t current_filter = -1;  // Current FIR filter (-1 is adaptive)
int8_t current_set = -1;     // Current FIR filter (-1 is adaptive)
int8_t set_filter = 10;      // bij adaptive 236 khz  
int8_t forced_mono;
int16_t LevelOffset;
int16_t Level;
int8_t mode;
int8_t AGC_tress;
int8_t IFplus;
int8_t RFplus;
int8_t Squelch;
int8_t Setsquelch;
int16_t nDeemphasis, volume;
uint32_t freq;
int8_t Filter_AM = 127;
int8_t Filter_FM = 127;

/* Scan */
uint16_t scan_start = 0;
uint16_t scan_end = 0;
uint16_t scan_step = 0;
uint8_t scan_filter = 0;
uint16_t AM_start_scan = 0;
uint16_t AM_scan_end = 0;
uint16_t AM_scan_step = 0;
uint8_t AM_scan_filter = 0;

#define TIMER_INTERVAL 66
#define DATA_TIMER_INTERVAL 87
byte DSP_I2C = 0x64;

int8_t radio_mode;
int8_t scan_mode;

static const uint8_t DSP_INIT[] PROGMEM =
{
  0x03, 0x1C, 0x00, 0x00,
  0x03, 0x1C, 0x00, 0x74,
  0x19, 0x1B, 0xF0, 0x00, 0x38, 0x38, 0xD0, 0x80, 0xF0, 0x00, 0x38, 0x40, 0xD0, 0x80, 0x43, 0xB2, 0x38, 0x43, 0xD0, 0x80, 0xF0, 0x00, 0x70, 0x00, 0xC2, 0xF7,
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  0x02, 0xFF, 100,
/* AM */
  0x05, 0x21, 0x0B, 0x01, 0x03, 0xFC,                                                                          // AM_Set_RFAGC                                - 102 dBuV                             
  0x0B, 0x21, 0x0E, 0x01, 0x00, 0x01, 0x00, 0x02, 0x04, 0xB0, 0x00, 0x03,                                      // AM_Set_CoChannelDet-Set sensitivity to 120% - default
  0x07, 0x21, 0x17, 0x01, 0x00, 0x01, 0x04, 0xB0,                                                              // AM 23 Set_NoiseBlanker       
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  0x07, 0x21, 0x37, 0x01, 0x00, 0x01, 0x05, 0xDC,                                                              // AM_Set_Highcut_Max
0
};

static const uint8_t INIT_EUS[] PROGMEM =
{
 /*TEF6686_add_and_improved_settings by eustake*/
 /* FM */
  0x05, 0x20, 0x14, 0x01, 0x00, 0x01,                                                                          // FM 20 Set_MphSuppression         (1, 1)
  0x05, 0x20, 0x16, 0x01, 0x00, 0x01,                                                                          // FM 22 Set_ChannelEqualizer       (1, 1)
  0x11, 0x20, 0x17, 0x01, 0x00, 0x01, 0x03, 0x20, 0x00, 0x00, 0x03, 0xE8, 0x00, 0x01, 0x00, 0x78, 0x0C, 0x80,  // FM 23 Set_NoiseBlanker           (1, 1, 800, 0, 1000, 1, 120, 3200)
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  0x05, 0x20, 0x56, 0x01, 0x05, 0x32,                                                                          // FM 86 Set_Bandwidth_Options      (1, 1330)
0
};

static const uint8_t INIT_EUS2[] PROGMEM =
{
 /*TEF6686_add_and_improved_settings by eustake*/
 /* FM */
  0x05, 0x20, 0x14, 0x01, 0x00, 0x01,                                                                          // FM 20 Set_MphSuppression         (1, 1)
  0x05, 0x20, 0x16, 0x01, 0x00, 0x01,                                                                          // FM 22 Set_ChannelEqualizer       (1, 1)
  0x11, 0x20, 0x17, 0x01, 0x00, 0x01, 0x01, 0xF4, 0x00, 0x00, 0x03, 0x20, 0x00, 0x01, 0x00, 0xB4, 0x08, 0x98,  // FM 23 Set_NoiseBlanker           (1, 1, 500, 0, 800, 1, 180, 2200)-011220
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  0x05, 0x20, 0x56, 0x01, 0x05, 0x32,                                                                          // FM 86 Set_Bandwidth_Options      (1, 1330)
//  0x07, 0x20, 0x5A, 0x01, 0x00, 0x64, 0x00, 0x1E,                                                              // FM_Set_StBandBlend_Time
//  0x0B, 0x20, 0x5B, 0x01, 0x05, 0xDC, 0x05, 0xDC, 0x05, 0xDC, 0x05, 0xDC,                                      // FM_Set_StBandBlend_Gain          (1, 1500, 1500, 1500, 1500)
//  0x0B, 0x20, 0x5C, 0x01, 0x00, 0xFA, 0x00, 0xFA, 0x00, 0xFA, 0x00, 0xFA,                                      // FM_Set_StBandBlend_Bias
//  0x0F, 0x30, 0x18, 0x01, 0x00, 0x05, 0x00, 0x00, 0xFF, 0x9C, 0x01, 0x90, 0xFF, 0x38, 0x03, 0xE8,              // AUDIO_Set_WaveGen
//  0x0D, 0x30, 0x16, 0x01, 0x00, 0x21, 0x00, 0x02, 0x00, 0x20, 0x01, 0x00, 0x12, 0xC0,                          // AUDIO_Set_Dig_IO
//  0x07, 0x30, 0x0D, 0x01, 0x00, 0x80, 0x00, 0xE0,                                                              // AUDIO_Set_Output_Source
//  0x0B, 0x20, 0x86, 0x01, 0x00, 0x00, 0x01, 0x9A, 0x03, 0xB6, 0x03, 0xE8,                                      // FM_Get_Processing_Status
  0
};

static const uint8_t INIT_EUS3[] PROGMEM =
{
 /*TEF6686_add_and_improved_settings by eustake*/
 /* FM */
  0x05, 0x20, 0x14, 0x01, 0x00, 0x01,                                                                          // FM 20 Set_MphSuppression         (1, 1)
  0x05, 0x20, 0x16, 0x01, 0x00, 0x00,                                                                          // FM 22 Set_ChannelEqualizer       (1, 0)
  0x11, 0x20, 0x17, 0x01, 0x00, 0x01, 0x01, 0xF4, 0x00, 0x00, 0x03, 0x20, 0x00, 0x01, 0x00, 0xB4, 0x08, 0x98,  // FM 23 Set_NoiseBlanker           (1, 1, 500, 0, 800, 1, 180, 2200)
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  0x05, 0x20, 0x56, 0x01, 0x05, 0x32,                                                                          // FM 86 Set_Bandwidth_Options      (1, 1330)
  0
};

static const uint8_t INIT_IMP[] PROGMEM =
{
  0x05, 0x20, 0x14, 0x01, 0x00, 0x01,                                                                         // FM 20 Set_MphSuppression       (1, 1)                                 improved 
  0x05, 0x20, 0x16, 0x01, 0x00, 0x01,                                                                         // FM 22 Set_ChannelEqualizer     (1, 1)                                 improved
  0x07, 0x20, 0x17, 0x01, 0x00, 0x01, 0x03, 0xE8,                                                             // FM 23 Set_NoiseBlanker         (1, 1, 1000)                           default
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  0x05, 0x20, 0x56, 0x01, 0x03, 0xB6,                                                                         // FM 86 Set_Bandwidth_Options    (1, 950)
0
};

const uint16_t FMFilterMap[32] PROGMEM = { 560, 720, 840, 1140, 1330, 1510, 1680, 1840, 2000, 2170, 2360, 2540, 2870, 3110, 3110, 3110, 560, 560, 560, 560, 560, 560, 560, 560, 560, 0, 640, 0, 840, 970, 0, 560 };
const uint8_t AMFilterMap[32] PROGMEM = { 60, 80, 80, 80, 80, 80, 80, 80, 80, 80, 80, 80, 80, 80, 80, 80, 30, 30, 30, 30, 40, 40, 40, 60, 60, 0, 80, 0, 80, 80, 0, 30 };

void Write(uint8_t *buf, uint8_t len)
{
  Wire.beginTransmission(DSP_I2C);
  for (int i = 0; i < len; i++)
    Wire.write(*buf++);
  Wire.endTransmission();
}

void Read(uint8_t *buf, uint8_t len)
{
  uint8_t lenrec = Wire.requestFrom(DSP_I2C, len);
  for (int i = 0; i < lenrec; i++)
    *buf++ = Wire.read();
}

void Set_Cmd(uint8_t mdl, uint8_t cmd, int len, ...)
{
  uint8_t buf[31];
  uint16_t temp;
  va_list vArgs;
  va_start(vArgs, len);
  buf[0] = mdl;
  buf[1] = cmd;
  buf[2] = 1;
  for (uint8_t i = 0; i < len; i++)
  {
    temp = va_arg(vArgs, uint16_t);
    buf[3 + i * 2] = (uint8_t)(temp >> 8);
    buf[4 + i * 2] = (uint8_t)temp;
  }
  va_end(vArgs);
  Write(buf, len * 2 + 3);
}

//void Get_Cmd(uint8_t mdl, uint8_t cmd, uint16_t *receive, int len)
void Get_Cmd(uint8_t mdl, uint8_t cmd, int16_t *receive, int len)
{
  uint8_t buf[3];
  buf[0] = mdl;
  buf[1] = cmd;
  buf[2] = 1;
  Write(buf, 3);
  Read((uint8_t*)receive, 2 * len);
  for (uint8_t i = 0; i < len; i++)
  {
    uint16_t newval = (uint8_t)(receive[i] >> 8) | (((uint8_t)(receive[i])) << 8);
    receive[i] = newval;
  }
}

void dsp_write_data(const uint8_t* data)
{
  uint8_t *pa = (uint8_t *)data;
  uint8_t len, i, first;
  for (;;)
  {
    len = pgm_read_byte_near(pa++);
    first = pgm_read_byte_near(pa);
    if (!len)
      break;
    if (len == 2 && first == 0xff)
    {
      int delaytime = pgm_read_byte_near(++pa);
      delay(delaytime);
      pa++;
    }
    else
    {
      Wire.beginTransmission(DSP_I2C);
      for (int i = 0; i < len; i++)
        Wire.write(pgm_read_byte_near(pa++));
      Wire.endTransmission();
    }
  }
}

void scan(bool continous)
{

  uint32_t freq;
  uint32_t buffer;

  if ( scan_start < 6500 )
  {
    scan_mode = 1;
    scan_start = AM_start_scan;
    scan_end = AM_scan_end;
    scan_step = AM_scan_step;
  }
  else
  {
    scan_mode = 0;
  }

  if (scan_mode == 0)
  {
    if (scan_filter == -1) {set_filter = 10;} else {set_filter = scan_filter;}
    Set_Cmd(32, 10, 4, scan_filter == -1 ? 1 : 0, pgm_read_word_near(FMFilterMap + set_filter), 1000, 1000);
    Set_Cmd(32, 1, 2, 1, scan_start);
  }
  else
  {
    Set_Cmd(33, 10, 2, scan_filter == -1 ? 1 : 0, pgm_read_byte_near(AMFilterMap + scan_filter));
    Set_Cmd(33, 1, 2, 1, scan_start);
  }
  do
  {
    Serial.print('U');
    for (freq = scan_start; freq <= scan_end; freq += scan_step)
    {
      Set_Cmd( scan_mode == 0 ? 32 : 33, 1, 2, 1, freq);
      Serial.print(scan_mode == 0 ? freq * 10 : freq, DEC);
      Serial.print('=');
      delay(10);

      int16_t uQuality[4] = { 0 };
      Get_Cmd(scan_mode == 0 ? 32 : 33, 128, uQuality, 4);
      Serial.print(uQuality[1] / 10, DEC);
      Serial.print(',');
    }

    Serial.print('\n');
  } while (continous && !Serial.available());
  //  Restore previous settings
  if (radio_mode == 0)
  {
    if (current_filter == -1) {set_filter = 10;} else {set_filter = current_filter;}
    Set_Cmd( 32, 10, 4, current_filter == -1 ? 1 : 0, pgm_read_word_near(FMFilterMap + set_filter), 1000, 1000);
    Set_Cmd( 32, 1, 2, 1, REG_FREQ / 10 );
  }
  else
  {
    Set_Cmd( 33, 10, 2, 0, pgm_read_byte_near(AMFilterMap + current_filter));
    Set_Cmd( 33, 1, 2, 1, REG_FREQ );
  }
}


void get_DATA()
{
  int16_t uDATA_Data[8] = {0};
  Get_Cmd(32, 131, uDATA_Data, 8);
  if ( bitRead(uDATA_Data[0], 15) == 1 )
  {
    Serial.print('P');
    serial_hex(uDATA_Data[1] >> 8);
    serial_hex(uDATA_Data[1]);
    Serial.print('\n');

    Serial.print('R');
    serial_hex(uDATA_Data[2] >> 8);
    serial_hex(uDATA_Data[2]);
    serial_hex(uDATA_Data[3] >> 8);
    serial_hex(uDATA_Data[3]);
    serial_hex(uDATA_Data[4] >> 8);
    serial_hex(uDATA_Data[4]);
    serial_hex(uDATA_Data[5] >> 8);
    Serial.print('\n');
  }
}

void serial_hex(uint8_t val)
{
  Serial.print((val >> 4) & 0xF, HEX);
  Serial.print(val & 0xF, HEX);
}

void Set_AGC_tresshold(uint8_t val)
{
 if (val == 0) {
  Set_Cmd(32, 11, 2, 920, 0);
  Set_Cmd(33, 11, 1, 1020);  
 } else if (val == 1) {
  Set_Cmd(32, 11, 2, 890, 0);
  Set_Cmd(33, 11, 1, 990);
 } else if (val == 2) {
  Set_Cmd(32, 11, 2, 870, 0);
  Set_Cmd(33, 11, 1, 970);
 } else {
  Set_Cmd(32, 11, 2, 840, 0);
  Set_Cmd(33, 11, 1, 940);
 }
}

void Set_IF_RF(uint8_t val, uint8_t val1)
{
  if (val == 1 && val1 == 0) {
     Set_Cmd(32, 39, 1, 60);
     Set_Cmd(33, 39, 1, 60);
  } else if (val == 0 && val1 == 1) {
     Set_Cmd(32, 39, 1, 60);
     Set_Cmd(33, 39, 1, 60);
  } else if (val == 1 && val1 == 1) {
     Set_Cmd(32, 39, 1, 120);
     Set_Cmd(33, 39, 1, 120);
  } else {
     Set_Cmd(32, 39, 1, 0);
     Set_Cmd(33, 39, 1, 0);

  }
}

void Set_Deempasis(uint8_t val)
{
  if (val == 0) { 
    Set_Cmd(32, 31, 1, 500);
  } else  if (val == 1) {
    Set_Cmd(32, 31, 1, 750);
  } else if (val == 2) {
    Set_Cmd(32, 31, 1, 0);
  }
}

void setup()
{
  Wire.begin();
  Serial.begin(115200);
  delay(40);
  int16_t uState;
  Get_Cmd(64, 128, &uState, 1);
  if (uState < 2)
    dsp_write_data(DSP_INIT);
  else if (uState > 2)
  {
    Set_Cmd(64, 1, 1, 1);
  }
  
  while (true)
  {
    if (Serial.available() > 0)
    {
      if (Serial.read() == 'x')
      {
        while (!Serial.available());
        if (Serial.read() == '\n')
          break;
      }
    }
  }
  delay(20);
  while (Serial.available() > 0)
    Serial.read();  // clear the serial buffer
  Serial.print("\nOK\n");
  if (AM_VOL_SCALE != -1) {
    int SetVolScale = map(AM_VOL_SCALE, 0, 100, -120, 60);
    Set_Cmd(33, 80, 1, SetVolScale);
  }
}

void loop()
{
  // check signal level and 19kHz subcarrier every TIMER_INTERVAL
  if ((millis() - timer) >= TIMER_INTERVAL)
  {
    Serial.print("S");
    if (radio_mode == 0){
      int16_t uStatus;
      Get_Cmd(32, 133, &uStatus, 1);
      if (forced_mono == 1){
        Serial.print('M');} 
      else { 
        char stereo = (uStatus & (1 << 15)) ? 's' : 'm';
        Serial.print(stereo);}
    }
    else {
      Serial.print('m');}
    int16_t uQuality[4] = { 0 };
    if (radio_mode == 0){
      Get_Cmd(32, 128, uQuality, 6);}
    else {
      Get_Cmd(33, 128, uQuality, 4);}
    if (uQuality[1] > 1200){uQuality[1] = 1200;}  // Schiet soms ver door zo begrenst tot max waarde datasheet
    Serial.print(uQuality[1] / 10, DEC);
    Serial.print(',');
    if ((uQuality[2] > 1000) && (radio_mode ==0)) {uQuality[2] = 1000;}  // Schiet soms boven de 1000 in datasheet is echter max wel 1000 
    if (radio_mode ==1){uQuality[2] = uQuality[2] / 5;}                  // voor am max 500% terugzet naar 100% 
    Serial.print(uQuality[2] / 10, DEC);
    Serial.print(',');
    Serial.print(uQuality[3] / 10, DEC);
    Serial.print('\n');
     timer = millis();}

  if (radio_mode == 0) {
    if ((millis() - timer_DATA) >= DATA_TIMER_INTERVAL)
    {
      get_DATA();
      timer_DATA = millis();
    }
  }

  if (Serial.available() > 0)
  {
    buff[buff_pos] = Serial.read();
    if (buff[buff_pos] != '\n' && buff_pos != SERIAL_BUFFER_SIZE - 1)
      buff_pos++;
    else {
      buff[buff_pos] = 0x00;
      buff_pos = 0;

      switch (buff[0])
      {

        case 'x':
          Serial.println("OK");
          break;

        case 'Y':  // Audio volume scaler
          volume = atoi(buff + 1);
          if (volume == 0) {
            Set_Cmd(48, 11, 1, 1);//mute
          } else {
            Set_Cmd(48, 11, 1, 0);//unmute
            //Set_Cmd(48, 10, 1, 0);
            int Setvolume = map(volume, 0, 100, -599, 50);
            Set_Cmd(48, 10, 1, Setvolume);
          }
          Serial.print("Y");
          Serial.println(volume);
          break;

        case 'S':
          if (buff[1] == 'a')
          {
            scan_start = (atol(buff + 2) + 5) / 10;
            AM_start_scan = atol(buff + 2);
          }
          else if (buff[1] == 'b')
          {
            scan_end = (atol(buff + 2) + 5) / 10;
            AM_scan_end = atol(buff + 2);
          }
          else if (buff[1] == 'c')
          {
            scan_step = (atol(buff + 2) + 5) / 10;
            AM_scan_step = atol(buff + 2);
          }
          else if (buff[1] == 'f')
          {
            scan_filter = atol(buff + 2);
          }
          else if (scan_start > 0 && scan_end > 0 && scan_step > 0 && scan_filter >= 0)
          {
            if (buff[1] == 'm')
              scan(true);   // Multiple (continous) scan
            else
              scan(false);  // Single scan
          }
          break;
          
        case 'B':
          forced_mono = atol(buff + 1);
          Set_Cmd(32, 66, 2, forced_mono == 1 ? 2 : 0 , 400);   
          Serial.print('B');
          Serial.print(forced_mono == 1 ? '1' : '0');
          Serial.print('\n');
          break;       

        case 'M':
          mode = atol(buff + 1);
          if (mode == 0){  
            if (MODF_FREQ == 0){MODF_FREQ = 87500;} 
            Set_Cmd(32, 1, 2, 1, MODF_FREQ / 10);
            Serial.println("M0");
            Serial.print('T');
            Serial.println(MODF_FREQ);
            if (Filter_AM != 127) {Filter_AM = current_filter;} 
			      if (Filter_FM == 127) {Filter_FM = -1;}
			      current_filter = Filter_FM;
            Set_Cmd(32, 10, 4, current_filter == -1 ? 1 : 0, pgm_read_word_near(FMFilterMap + current_filter), 1000, 1000);
            radio_mode = 0;
          } else {
            if (MODA_FREQ == 0){MODA_FREQ = 522;} 
            Set_Cmd(33, 1, 2, 1, MODA_FREQ);
            Serial.println("M1");
            Serial.print('T');
            Serial.println(MODA_FREQ);
			      Filter_FM = current_filter;
	          if (Filter_FM != 127) {Filter_FM = current_filter;} 
   	        if (Filter_AM == 127) {Filter_AM = 21;}
            current_filter = Filter_AM;
            Set_Cmd(33, 10, 2, 0, pgm_read_byte_near(AMFilterMap + current_filter));
            radio_mode = 1;
          }
          Serial.print('F');
          Serial.println(current_filter);
          Serial.print('V');
          Serial.println(LevelOffset);
          break;
                 
        case 'T':  // Tune to a frequency (to do keep filter settings)
          freq = atol(buff + 1);
          REG_FREQ = freq;
          if ((REG_FREQ >= 65000) && (REG_FREQ <= 108000)) {
            Set_Cmd(32, 1, 2, 1, REG_FREQ / 10);
            Serial.println("M0");
            Serial.print('T');
            Serial.println(REG_FREQ);
            if (radio_mode == 1) {                         // from AM to FM then switch to adaptive filter AUTO in xdr-gtk
              if (Filter_AM != 127) {Filter_AM = current_filter;} 
			        if (Filter_FM == 127) {Filter_FM = -1;}
			        current_filter = Filter_FM;
              Set_Cmd(32, 10, 4, current_filter == -1 ? 1 : 0, pgm_read_word_near(FMFilterMap + current_filter), 1000, 1000);
            }
            radio_mode = 0;
            MODF_FREQ = REG_FREQ;
          } else if ((REG_FREQ >= 144) && (REG_FREQ <= 26999)) {
              Set_Cmd(33, 1, 2, 1, REG_FREQ);
              Serial.println("M1");
              Serial.print('T');
              Serial.println(REG_FREQ);
              if (radio_mode == 0) {                       // from FM to AM then use filter 21 3,9khz 4khz   
                if (Filter_FM != 127) {Filter_FM = current_filter;} 
				        if (Filter_AM == 127) {Filter_AM = 21;}
                current_filter = Filter_AM;
                Set_Cmd(33, 10, 2, 0, pgm_read_byte_near(AMFilterMap + current_filter));
              }
              radio_mode = 1;
              MODA_FREQ = REG_FREQ;
          } 
          Serial.print('F');
          Serial.println(current_filter);
          Serial.print('V');
          Serial.println(LevelOffset);
          break;

        case 'F':  // Change FIR filters
          current_filter = atoi(buff + 1);
          if (radio_mode == 0) {
            if (current_filter == -1) {set_filter = 10;} else {set_filter = current_filter;}
            Set_Cmd(32, 10, 4, current_filter == -1 ? 1 : 0, pgm_read_word_near(FMFilterMap + current_filter), 1000, 1000);
          }
          else {
            Set_Cmd(33, 10, 2, 0, pgm_read_byte_near(AMFilterMap + current_filter));
          }
          Serial.print('F');
          Serial.println(buff + 1);
          break;
        
        case 'V':      // Set AM lna (in XDR-GTL enable Show antenna input alignment) (NO FM)
          LevelOffset = atoi(buff + 1);
          Level = map(LevelOffset, 0, 127, 0, 360);
          if (radio_mode == 1) {Set_Cmd(33, 12, 1, Level);}
          Serial.print('V');
          Serial.println(buff + 1);
          break;


        case 'Q':  // Audio volume scaler
          Squelch = atoi(buff + 1);
          if (Squelch != -1 && AM_VOL_SCALE == -1) {
            int Setsquelch = map(Squelch, 0, 100, -120, 60);
            Set_Cmd(33, 80, 1, Setsquelch);
            Serial.print("Q");
            Serial.println(Squelch);
          } 
          break;

        case 'D':  // Change the de-emphasis
          nDeemphasis = atoi(buff + 1);
          Serial.print("D");
          Set_Deempasis(nDeemphasis);
          Serial.println(nDeemphasis);
          break;

        case 'G':
          Serial.print('G');
          RFplus = buff[1] - 48;
          IFplus = buff[2] - 48;
          Set_IF_RF(RFplus,IFplus);
          Serial.print(RFplus);
          Serial.println(IFplus);
          break;

        case 'A':  // AGC  (check what levelstepping does)
          Serial.print('A');
          AGC_tress = atoi(buff + 1);
          Set_AGC_tresshold(AGC_tress);
          Serial.println(AGC_tress);
          break;

        case 'Z':
          Serial.print('Z');
          if (buff[1] == '0') {
              dsp_write_data(INIT_EUS);
            Serial.print("0");
          } else if (buff[1] == '1') {
              dsp_write_data(INIT_EUS2);
            Serial.print("1");
          } else if (buff[1] == '2') {
              dsp_write_data(INIT_EUS3);
            Serial.print("2");
          } else if (buff[1] == '3') {
              dsp_write_data(INIT_IMP);
            Serial.print("3");
          } else {
            Serial.print("4");
          }
          Serial.print('\n');
          Set_AGC_tresshold(AGC_tress);
          Set_IF_RF(RFplus,IFplus);
          Set_Deempasis(nDeemphasis);
          break;

       
        case 'X':  // shutdown
          Set_Cmd(64, 1, 1, 1);
          TWCR = 0;  // Release SDA and SCL lines used by hardware I2C
          Serial.println("X");
          delay(10);
          asm("jmp 0");
          break;
      }
    }
  }
}

/*  Happy DXing !  */
